//1.30 23:11 add some interface for different blade
//1.31 2:15  change the lasting time for each frame
//1.31 12:06 change some parameters
//1.31 12:35 complete the parameters of pins


#include "cmsis_os.c"
#define u8 char
#define ID30_TIME 50 //lasting time for each frame
int P1;
typedef struct{
    u8 RED;
    u8 GREEN;
    u8 BLUE;
} RGB;//the data structure of RGB

RGB RED    = {255,  0,  0};
RGB BLUE_D = {  0,  0,255};
RGB ORANGE = {250,128, 10};
RGB BLUE_C = {130,206,255};

typedef int Pin_Type; //TODO: port mapping
void HAL_GPIO_WritePin(GPIO_TypeDef *GPIOx, uint16_t GPIO_Pin, GPIO_PinState PinState);

//each row represents a group or half arrow
///////////////////////////////the 1st frame//////////////////////////////////////
u8 ID1[]={
0x00,0x81,0xb3,0x66,0x3b,0x18,0x00,
0x00,0x81,0xb3,0x66,0x3b,0x18,0x00,
0x00,0x81,0xb3,0x66,0x3b,0x18,0x00,
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0x00,0x81,0xb3,0x66,0x3b,0x18,0x00
};
/////////////////////////////////the 2nd frame////////////////////////////////////
u8 ID2[]={
0x00,    
0x00,0x81,0xb3,0x66,0x3b,0x18,0x00,
0x00,0x81,0xb3,0x66,0x3b,0x18,0x00,
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0x00,0x81,0xb3,0x66,0x3b,0x18
};
///////////////////////////////the 3rd frame//////////////////////////////////////
u8 ID3[]={
0x18,0x00,    
0x00,0x81,0xb3,0x66,0x3b,0x18,0x00,
0x00,0x81,0xb3,0x66,0x3b,0x18,0x00,
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0x00,0x81,0xb3,0x66,0x3b
};
///////////////////////////////the 4th frame//////////////////////////////////////
u8 ID4[]={
0x3b,0x18,0x00,    
0x00,0x81,0xb3,0x66,0x3b,0x18,0x00,
0x00,0x81,0xb3,0x66,0x3b,0x18,0x00,
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0x00,0x81,0xb3,0x66
};
///////////////////////////////the 5th frame//////////////////////////////////////
u8 ID5[]={
0x66,0x3b,0x18,0x00,    
0x00,0x81,0xb3,0x66,0x3b,0x18,0x00,
0x00,0x81,0xb3,0x66,0x3b,0x18,0x00,
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0x00,0x81,0xb3
};
///////////////////////////////the 6th frame//////////////////////////////////////
u8 ID6[]={
0xb3,0x66,0x3b,0x18,0x00,    
0x00,0x81,0xb3,0x66,0x3b,0x18,0x00,
0x00,0x81,0xb3,0x66,0x3b,0x18,0x00,
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0x00,0x81
};
///////////////////////////////the 7th frame//////////////////////////////////////
u8 ID7[]={
0x81,0xb3,0x66,0x3b,0x18,0x00,    
0x00,0x81,0xb3,0x66,0x3b,0x18,0x00,
0x00,0x81,0xb3,0x66,0x3b,0x18,0x00,
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0x00,
};
///////////////////////////////full frame//////////////////////////////////////
u8 ID_full[]={
0xff,0xff,0xff,0xff,0xff,0xff,0xff,
0xff,0xff,0xff,0xff,0xff,0xff,0xff,
0xff,0xff,0xff,0xff,0xff,0xff,0xff,
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0xff,0xff,0xff,0xff,0xff,0xff,0xff,
};




void WS2812B_Send_ABit(GPIO_TypeDef *GPIOx, uint16_t GPIO_Pin,u8 VAL){//send a bit of data, needing high precision timing 
    if(VAL==1){
        HAL_GPIO_WritePin(GPIOx,Data_send,GPIO_PIN_SET);//Data_send=1;
        osDelay(0.8);
        HAL_GPIO_WritePin(GPIOx,Data_send,GPIO_PIN_RESET);//Data_send=0;
        osDelay(0.45);//the delay after high level is the most important??
    }
    else{
        HAL_GPIO_WritePin(GPIOx,Data_send,GPIO_PIN_SET);//Data_send=1;
        osDelay(0.4);
        HAL_GPIO_WritePin(GPIOx,Data_send,GPIO_PIN_RESET);//Data_send=0;
        osDelay(0.85);
    }
}

void WS2812B_Send_A_RGB(GPIO_TypeDef *GPIOx, uint16_t GPIO_Pin,RGB* RGB_VAL){//the sequence is GRB
    int cnt;
    for(cnt=0;cnt<8;cnt++){
        WS2812B_Send_ABit(GPIOx,GPIO_Pin,RGB_VAL->GREEN>>(7-cnt)&0x01);//high bit first
    }
    for(cnt=0;cnt<8;cnt++){
        WS2812B_Send_ABit(GPIOx,GPIO_Pin,RGB_VAL->RED>>(7-cnt)&0x01);//high bit first
    }
    for(cnt=0;cnt<8;cnt++){
        WS2812B_Send_ABit(GPIOx,GPIO_Pin,RGB_VAL->BLUE>>(7-cnt)&0x01);//high bit first
    }
}

void WS2812B_Send_A_Line(GPIO_TypeDef *GPIOx, uint16_t GPIO_Pin,u8 line,RGB* RGB_VAL,u8 ood_even){ //which is divided into odd num and even
    RGB RGB_NONE={0,0,0};//no color
    int cnt;
    if(ood_even%2){//odd: from the high to the low is corresponding to from the left to the right
        for(cnt=0;cnt<8;cnt++){
            if((line>>(7-cnt)&0x01)==1){
                WS2812B_Send_A_RGB(GPIOx,GPIO_Pin,RGB_VAL);
            }
            else{
                WS2812B_Send_A_RGB(GPIOx,GPIO_Pin,&RGB_NONE);
            }
        }
    }
    else{//even: from the high to the low is corresponding to from the left to the right
        for(cnt=0;cnt<8;cnt++){
            if((line>>cnt&0x01)==1){
                WS2812B_Send_A_RGB(GPIOx,GPIO_Pin,RGB_VAL);
            }
            else{
                WS2812B_Send_A_RGB(GPIOx,GPIO_Pin,&RGB_NONE);
            }
        }
    }
}
//transport data of each frame
void WS2812B_Send_A_Part(GPIO_TypeDef *GPIOx, uint16_t GPIO_Pin,u8* part,u8 num,RGB* RGB_VAL){
    u8 cnt=1;
    for(cnt=1;cnt<=num;cnt++){
        WS2812B_Send_A_Line(GPIOx,GPIO_Pin,(part+cnt-1),RGB_VAL,cnt);
    }
}

void Display_Flow(GPIO_TypeDef *GPIOx, uint16_t GPIO_Pin,RGB* COLOR){
    WS2812B_Send_A_Part(GPIOx,GPIO_Pin,ID1,sizeof(ID1),COLOR);
    delay_ms(ID30_TIME);
    WS2812B_Send_A_Part(GPIOx,GPIO_Pin,ID2,sizeof(ID2),COLOR);
    delay_ms(ID30_TIME);
    WS2812B_Send_A_Part(GPIOx,GPIO_Pin,ID3,sizeof(ID3),COLOR);
    delay_ms(ID30_TIME);
    WS2812B_Send_A_Part(GPIOx,GPIO_Pin,ID4,sizeof(ID4),COLOR);
    delay_ms(ID30_TIME);
    WS2812B_Send_A_Part(GPIOx,GPIO_Pin,ID5,sizeof(ID5),COLOR);
    delay_ms(ID30_TIME);
    WS2812B_Send_A_Part(GPIOx,GPIO_Pin,ID6,sizeof(ID6),COLOR);
    delay_ms(ID30_TIME);
    WS2812B_Send_A_Part(GPIOx,GPIO_Pin,ID7,sizeof(ID7),COLOR);
    delay_ms(ID30_TIME);
}

void Display_Full(GPIO_TypeDef *GPIOx, uint16_t GPIO_Pin,RGB* COLOR){
    WS2812B_Send_A_Part(GPIOx,GPIO_Pin,ID_full,sizeof(ID_full),COLOR);
    delay_us(25);
}